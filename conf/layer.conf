## conf/layer.conf
```bitbake
#
# Copyright (C) 2019 Wind River Systems, Inc.
#

# We have a conf and classes directory, add to BBPATH
BBPATH =. "${LAYERDIR}:"

LAYERRECOMMENDS_wr-xilinx-zynqmp  = "xilinx-zynqmp-dl"

# We have a packages directory, add to BBFILES
BBFILES += "${LAYERDIR}/recipes-*/*/*.bb \
	${LAYERDIR}/recipes-*/*/*.bbappend"


BBFILE_COLLECTIONS += "wr-xilinx-zynqmp"
BBFILE_PATTERN_wr-xilinx-zynqmp := "^${LAYERDIR}/"
BBFILE_PRIORITY_wr-xilinx-zynqmp = "7"

# This should only be incremented on significant changes that will
# cause compatibility issues with other layers
LAYERVERSION_wr-xilinx-zynqmp = "1"

LAYERDEPENDS_wr-xilinx-zynqmp = "core wrlinux xilinx-tools xilinx"
LAYERSERIES_COMPAT_wr-xilinx-zynqmp = "thud wrl warrior zeus"

# We have a pre-populated downloads directory, add to PREMIRRORS
PREMIRRORS_append = " \
     .*://.*/.* file://${LAYERDIR}/downloads/ \n \
     git://.*/.* git://${LAYERDIR}/git/MIRRORNAME;protocol=file \n \
"
BANNER[xilinx-zynqmp_default] = "The xilinx-zynqmp layer includes third party components, where additional third party licenses may apply."
```

## conf/machine/xilinx-zynqmp.conf
```bitbake
#@TYPE: Machine
#@NAME: xilinx-zynqmp
#@DESCRIPTION: Machine configuration for Zynq Ultrascale+ MPSoC

require xilinx-zynqmp.inc
EXTRA_IMAGECMD_jffs2 = "--pad --no-cleanmarkers --eraseblock=128"
```

## conf/machine/xilinx-zynqmp.inc
```bitbake
#@TYPE: Machine inc.
#@NAME: zynqmp layer

DEFAULTTUNE = "cortexa53"
require conf/machine/include/tune-cortexa53.inc

MACHINE_FEATURES += "ext3 pci usbgadget usbhost vfat keyboard network"

KERNEL_IMAGETYPE = "Image"
KERNEL_DEVICETREE_xilinx-zynqmp = "xilinx/zynqmp-zcu102-rev1.0.dtb xilinx/zynqmp-zcu102-rev1.0-canfd.dtb"

SERIAL_CONSOLE = "115200 ttyPS0"

PREFERRED_PROVIDER_virtual/kernel ??= "linux-yocto"
PREFERRED_VERSION_linux-yocto ?= "5.10%"

MACHINE_EXTRA_RRECOMMENDS = " kernel-modules kernel-devicetree"
IMAGE_FSTYPES += "tar.bz2 wic wic.bmap"

# wic support
WKS_FILE ?= "zynqmp-sdimage.wks"
do_image_wic[depends] += "mtools-native:do_populate_sysroot dosfstools-native:do_populate_sysroot"
IMAGE_BOOT_FILES ?= " Image zynqmp-zcu102-rev1.0.dtb "

# multilib support
MULTILIBS ?= "multilib:lib32"
DEFAULTTUNE_virtclass-multilib-lib32 ?= "armv7athf-neon"

XSERVER_append += "xf86-video-armsoc"
OSTREE_BOOTLOADER_INCLUDE ?= ""
OSTREE_SD_UBOOT_WIC1 ?= ""
OSTREE_SD_BOOT_ALIGN ?= "4096"
OSTREE_FDISK_BLM ?= "8192"
OSTREE_FDISK_FSZ ?= "132"
OSTREE_KERNEL ?= "Image"
OSTREE_UBOOT_CMD ?= "booti"
OSTREE_WKS_EFI_SIZE ?= "--size=64M"
INSTAB ?= "1"

MACHINEOVERRIDES_prepend_xilinx-zynqmp = "mali400:zynqmp:zynqmpeg:"
```

## scripts/lib/wic/canned-wks/sdimage.wks
```
# short-description: Create a sd disk image (SD card)
# long-description: Create a partitioned disk image for Xilinx-zynqmp
# The first partition is NULL, reserved for uboot with Xilinx bitstream.
# The second partition is to accommodate kernel, dtb and rootfs, if the
# volome is not enough as rootfs, feel free to expand it by adding --size,
# like --size=1024.

part / --ondisk mmcblk --label fat16 --size 128 --align 4
part / --source rootfs --ondisk mmcblk --fstype=ext4 --label rootfs --align 1024
```

## zynqmp-secure-boot/conf/layer.conf
```bitbake
#
# Copyright (C) 2019 Wind River Systems, Inc.
#

# We have a conf and classes directory, add to BBPATH
BBPATH .= ":${LAYERDIR}"

require zynqmp-secure-boot.inc

# We have a packages directory, add to BBFILES
BBFILES += "${LAYERDIR}/recipes-*/*/*.bb \
	${LAYERDIR}/recipes-*/*/*.bbappend \
	${LAYERDIR}/classes/*.bbclass"

BBFILE_COLLECTIONS += "zynqmp-secure-layer"
BBFILE_PATTERN_zynqmp-secure-layer := "^${LAYERDIR}/"
BBFILE_PRIORITY_zynqmp-secure-layer = "7"

INSECURE_KEY_MSG = "\
WARNING: The insecure sample keys are used for secure Boot.\
Please ensure that you are aware of what your risk to use these keys in your own product."

# Warn the user if sample key is used
BANNER[xilinx-zynqmp_default] = "${INSECURE_KEY_MSG}"

LAYERSERIES_COMPAT_zynqmp-secure-layer = "wrl warrior zeus"

LAYER_PATH_zynqmp-secure-layer = "${LAYERDIR}"
```
